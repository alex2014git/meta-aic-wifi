## conf/layer.conf
```bitbake
LAYERSERIES_COMPAT_aicwifi = "kirkstone"
BBPATH .= ":${LAYERDIR}"

BBFILES += "${LAYERDIR}/recipes-*/*/*.bb \
            ${LAYERDIR}/recipes-*/*/*.bbappend"

BBFILE_COLLECTIONS += "aicwifi"
BBFILE_PATTERN_aicwifi := "^${LAYERDIR}/"
BBFILE_PRIORITY_aicwifi = "8"
```
